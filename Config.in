## Config.in
```kconfig
################################################################################
# SPDX-License-Identifier: LGPL-3.0-only
#
# This file is part of DMod.
# Copyright (C) 2024 Grégor Boirie <gregor.boirie@free.fr>
################################################################################

config DMOD_ASSERT_API
	bool "API assertion"
	default n
	help
	  Build DMod with high-level API assertions enabled to ensure that API
	  functions exposed by DMod will perform full verification of
	  arguments consistency.

config DMOD_ASSERT_INTERN
	bool "Internal assertion"
	select DMOD_ASSERT_API
	default n
	help
	  Build DMod library with internal assertions enabled to check for
	  internal DMod behavioral consistency.

config DMOD_KVSTORE
	bool "KVStore support"
	default y
	help
	  Build DMod library with KVStore support for transactions and
	  iterators.

config DMOD_XACT_NULL
	bool "Dummy null transaction"
	default n
	help
	  Build DMod library with support for dummy / null transactions.

# ex: ft=kconfig:
```
